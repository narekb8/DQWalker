#include "Menus.h"
#include "Arduino.h"
#include <Adafruit_GFX.h>
#include "Monster.h"
#include "Player.h"
#include <queue>

const unsigned char info [] PROGMEM = {
	// 'Untitled, 128x128px
	0xff, 0xff, 0xff, 0xff, 0xff, 0xff, 0xff, 0xff, 0xff, 0xff, 0xff, 0xff, 0xff, 0xff, 0xff, 0xff, 
	0xff, 0xff, 0xff, 0xff, 0xff, 0xff, 0xff, 0xff, 0xff, 0xff, 0xff, 0xff, 0xff, 0xff, 0xff, 0xff, 
	0xff, 0xff, 0xff, 0xff, 0xff, 0xff, 0xff, 0xff, 0xff, 0xff, 0xff, 0xff, 0xff, 0xff, 0xff, 0xff, 
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	0xff, 0xff, 0xff, 0xff, 0xff, 0xff, 0xff, 0xff, 0xff, 0xff, 0xff, 0xff, 0xff, 0xff, 0xff, 0xff
};

const unsigned char main2 [] PROGMEM = {
	// 'mainMenu, 128x128px
	0x00, 0x00, 0x00, 0x00, 0x00, 0x00, 0x00, 0x00, 0x00, 0x00, 0x00, 0x00, 0x00, 0x00, 0x00, 0x00, 
	0x00, 0x00, 0x00, 0x00, 0x00, 0x00, 0x00, 0x00, 0x00, 0x00, 0x00, 0x00, 0x00, 0x00, 0x00, 0x00, 
	0x00, 0x00, 0x00, 0x00, 0x00, 0x00, 0x00, 0x00, 0x00, 0x00, 0x00, 0x00, 0x00, 0x00, 0x00, 0x00, 
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	0x00, 0x00, 0x00, 0x00, 0x00, 0x00, 0x00, 0x00, 0x00, 0x00, 0x00, 0x00, 0x00, 0x00, 0x00, 0x00
};

const unsigned char statsIcon [] PROGMEM = {
	// 'statsIcon, 32x32px
	0x00, 0x00, 0x00, 0x00, 0x00, 0x00, 0x00, 0x00, 0x00, 0x00, 0x00, 0x00, 0x00, 0xf0, 0x3c, 0x00, 
	0x06, 0x1e, 0x07, 0x80, 0x06, 0x03, 0xc0, 0xf0, 0x00, 0x00, 0x00, 0x00, 0x00, 0x00, 0x00, 0x00, 
	0x00, 0x00, 0x00, 0x00, 0x00, 0x00, 0x00, 0x00, 0x00, 0xf0, 0x3c, 0x00, 0x06, 0x1e, 0x07, 0x80, 
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	0x06, 0x03, 0xc0, 0xf0, 0x00, 0x00, 0x00, 0x00, 0x00, 0x00, 0x00, 0x00, 0x00, 0x00, 0x00, 0x00
};

const unsigned char statsMini [] PROGMEM = {
	// 'statsMini, 16x16px
	0x00, 0x00, 0x00, 0x00, 0x03, 0x80, 0x08, 0xe0, 0x00, 0x00, 0x00, 0x00, 0x00, 0x00, 0x03, 0x80, 
	0x08, 0xe0, 0x00, 0x00, 0x00, 0x00, 0x00, 0x00, 0x03, 0x80, 0x08, 0xe0, 0x00, 0x00, 0x00, 0x00
};

// Array of all bitmaps for convenience. (Total bytes used to store images in PROGMEM = 1088)
const uint16_t* desert_tiles[4] = {
	desert_tiles_Ground,
	desert_tiles_Grass,
	desert_tiles_Mound,
	desert_tiles_Mountain
};

// Array of all bitmaps for convenience. (Total bytes used to store images in PROGMEM = 1088)
const uint16_t* ice_tiles[4] = {
	ice_tiles_Ground,
	ice_tiles_Mound,
	ice_tiles_Tree,
	ice_tiles_Mountain
};

// Array of all bitmaps for convenience. (Total bytes used to store images in PROGMEM = 1632)
const uint16_t* limbo_tiles[6] = {
	limbo_tiles_Ground,
	limbo_tiles_Mound,
	limbo_tiles_Tree,
	limbo_tiles_Mountain,
	limbo_tiles_Corner,
	limbo_tiles_Wall
};

// Array of all bitmaps for convenience. (Total bytes used to store images in PROGMEM = 1632)
const uint16_t* sea_tiles[6] = {
	sea_tiles_Ground,
	sea_tiles_Grass,
	sea_tiles_Rock,
	sea_tiles_Mountain,
	sea_tiles_Corner,
	sea_tiles_Wall
};

// Array of all bitmaps for convenience. (Total bytes used to store images in PROGMEM = 1632)
const uint16_t* sky_tiles[6] = {
	sky_tiles_Ground,
	sky_tiles_Mound,
	sky_tiles_Tree,
	sky_tiles_Mountain,
	sky_tiles_Corner,
	sky_tiles_Wall
};

int dRow[] = { -1, 0, 1, 0 };
int dCol[] = { 0, 1, 0, -1 };

int dir[] = {0, 1};
int new_dir[] = {0, 1};

int x = 0;
int y = 0;

uint8_t score = 0;

Menus::Menus(BlockNot *time)
{
    currMenu = 0;
    currSubMenu = 0;
	currMap = 0;
	for(int i = 0; i < 8; i++)
	{
		for(int j = 0; j < 8; j++)
			mapArr[i][j] = 0;
	}

	randomSeed(analogRead(3));
	previous = random(64);
	gameTimer = time;
}

void Menus::drawIcon(int x, int y, bool up, Sharp_Color_LCD *display, Player *player)
{
	display->setRotation(1);
	Monster *mon = player->getCurr();
	const uint16_t *monsterAnim = mon->getPixelData(currAnim[0], currAnim[1]);
	int scale = (up) ? 2 : 1;
	for(int i = 0; i < 16; i++)
	{
		for(int j = 0; j < 16; j++)
		{
			uint8_t pixel = (dir[0] == -1) ? 16 - j + (16 * i) : j + (16 * i);
			if(monsterAnim[pixel] != 0xFFFF)
			{
				display->drawPixel(x+j*scale, y+i*scale, monsterAnim[pixel]);
				display->drawPixel(x+j*scale + scale/2, y+i*scale, monsterAnim[pixel]);
				display->drawPixel(x+j*scale, y+i*scale + scale/2, monsterAnim[pixel]);
				display->drawPixel(x+j*scale + scale/2, y+i*scale + scale/2, monsterAnim[pixel]);
			}
			else if(up)
			{
				display->drawPixel(x+j*scale, y+i*scale, monsterAnim[pixel]);
				display->drawPixel(x+j*scale + scale/2, y+i*scale, monsterAnim[pixel]);
				display->drawPixel(x+j*scale, y+i*scale + scale/2, monsterAnim[pixel]);
				display->drawPixel(x+j*scale + scale/2, y+i*scale + scale/2, monsterAnim[pixel]);
			}
		}
	}
}

void Menus::drawIcon(int x, int y, bool up, Sharp_Color_LCD *display)
{
	display->setRotation(1);
	const uint16_t *monsterAnim = epd_bitmap_Treasure;
	int scale = (up) ? 2 : 1;
	for(int i = 0; i < 16; i++)
	{
		for(int j = 0; j < 16; j++)
		{
			uint8_t pixel = (dir[0] == -1) ? 16 - j + (16 * i) : j + (16 * i);
			if(monsterAnim[pixel] != 0xFFFF)
			{
				display->drawPixel(x+j*scale, y+i*scale, monsterAnim[pixel]);
				display->drawPixel(x+j*scale + scale/2, y+i*scale, monsterAnim[pixel]);
				display->drawPixel(x+j*scale, y+i*scale + scale/2, monsterAnim[pixel]);
				display->drawPixel(x+j*scale + scale/2, y+i*scale + scale/2, monsterAnim[pixel]);
			}
			else if(up)
			{
				display->drawPixel(x+j*scale, y+i*scale, monsterAnim[pixel]);
				display->drawPixel(x+j*scale + scale/2, y+i*scale, monsterAnim[pixel]);
				display->drawPixel(x+j*scale, y+i*scale + scale/2, monsterAnim[pixel]);
				display->drawPixel(x+j*scale + scale/2, y+i*scale + scale/2, monsterAnim[pixel]);
			}
		}
	}
}

void Menus::farmMenu(Sharp_Color_LCD *display, Player *player)
{
	display->setRotation(1);
	Monster *mon = player->getCurr();
	display->fillScreen(0x0000);
	const unsigned char* pixelData = info;
	uint16_t *stats = mon->getStats();
	const uint16_t *monsterAnim = mon->getPixelData(currAnim[0], currAnim[1]);

	display->drawBitmap(0, 0, pixelData, 128, 128, 0xFFFF);
	drawIcon(10, 48, true, display, player);

	String s;
	switch (mon->breed)
	{
	case basic:
		s = "Slime";
		break;
	case halo:
		s = "HaloSlime";
		break;
	case puddle:
		s = "Babble";
		break;
	case clam:
		s = "PearlGel";
		break;
	case jellyfish:
		s = "Healer";
		break;
	}

	display->setTextSize(1);
    display->cp437(true);
    display->setCursor(35,8);
    display->setTextColor(0, 0xFFFF);
    display->print(s);
    if(stats[1]) display->write(0xC);
	else display->write(0xB);

    display->setCursor(60,28);
    display->setTextSize(1.25f);
    display->printf("LVL : %02d", stats[0]);
    display->setCursor(60,40);
    display->printf("ATK :%03d", stats[2]);
    display->setCursor(60,52);
    display->printf("DEF :%03d", stats[3]);
    display->setCursor(60,64);
    display->printf("AGL :%03d", stats[4]);
    display->setCursor(60,76);
    display->printf("INT :%03d", stats[5]);

    display->setCursor(60,98);
    display->printf("HP  :%03d", stats[6]);
    display->setCursor(60,110);
    display->printf("MP  :%03d", stats[7]);

	display->refresh();
}

void Menus::changeMenu(int mIndex, int smIndex, Sharp_Color_LCD *display, Player *mon)
{
	display->fillScreen(0xFFFF);
    switch(mIndex)
    {
		case stats:
			currAnim[0] = 0;
			currAnim[1] = 0;
			currMenu = stats;
			drawStats(display, mon);
			break;

        case farm:
			currAnim[0] = 0;
			currAnim[1] = 0;
			currMenu = farm;
			farmMenu(display, mon);
            break;

		case game:
			currAnim[0] = 0;
			currAnim[1] = 0;
			currSubMenu = currMap;
			generateNewMap((maps)currSubMenu);
			drawMap((maps)currSubMenu, display, mon);
			gameTimer->reset();
			currMenu = game;
            break;

		case front:
			currAnim[0] = 0;
			currAnim[1] = 0;
			currMenu = front;
			currSubMenu = 0;
			drawMain(display, mon);
			break;

		case lb:
			currAnim[0] = 0;
			currAnim[1] = 0;
			currMenu = lb;
			currSubMenu = 0;
			endGame(display, mon);
    }
}

const unsigned char* Menus::getPixelData(int mIndex, int smIndex)
{
    return info;
}

void Menus::updateMenu(commands input, Sharp_Color_LCD *display, Player *mon)
{
	switch(currMenu)
    {
		case stats:
			updateStats(input, display, mon);
			break;

		case farm:
			updateFarm(input, display, mon);
            break;

		case game:
			currAnim[1] ^= HIGH;
			gameTick(input, display, mon);
			updateAnim(display, mon);
            break;

		case front:
			updateMain(input, display, mon);
			break;

		case lb:
			changeMenu(front, 0, display, mon);
			break;
    }
}

void Menus::updateAnim(Sharp_Color_LCD *display, Player *mon)
{
	display->setRotation(1);
	switch(currMenu)
	{
		case farm:
			currAnim[1] ^= HIGH;
			drawIcon(10, 48, true, display, mon);
			display->refresh();
            break;
		
		case game:
			currAnim[1] ^= HIGH;
			switch (currSubMenu)
			{
				case desert:
					display->drawRGBBitmap(x*16, y*16, desert_tiles[0], 16, 16);
					break;
				case ice:
					display->drawRGBBitmap(x*16, y*16, ice_tiles[0], 16, 16);
					break;
				case sea:
					display->drawRGBBitmap(x*16, y*16, sea_tiles[0], 16, 16);
					break;
				case sky:
					display->drawRGBBitmap(x*16, y*16, sky_tiles[0], 16, 16);
					break;
				case limbo:
					display->drawRGBBitmap(x*16, y*16, limbo_tiles[0], 16, 16);
					break;
			}
			drawIcon(x*16, y*16, false, display, mon);
			display->refresh();
            break;
	}
}

void Menus::drawMap(maps screen, Sharp_Color_LCD *display, Player *mon)
{
	display->setRotation(1);
	switch (screen)
	{
		case desert:
			for(int i = 0; i < 8; i++)
			{
				for(int j = 0; j < 8; j++)
				{
					if(mapArr[i][j] == 0) display->drawRGBBitmap(i*16, j*16, desert_tiles[0], 16, 16);
					else if(mapArr[i][j] == 1) display->drawRGBBitmap(i*16, j*16, desert_tiles[1], 16, 16);
					else if(mapArr[i][j] == 2) display->drawRGBBitmap(i*16, j*16, desert_tiles[2], 16, 16);
					else if(mapArr[i][j] == 4)
					{
						display->drawRGBBitmap(i*16, j*16, desert_tiles[0], 16, 16);
						display->drawRGBBitmap(i*16, j*16, epd_bitmap_Treasure, epd_bitmap_Treasure_Mask, 16, 16);
					}
					else if(mapArr[i][j] == 5)
					{
						display->drawRGBBitmap(i*16, j*16, desert_tiles[0], 16, 16);
						drawIcon(i*16, j*16, false, display, mon);
					}
					else display->drawRGBBitmap(i*16, j*16, desert_tiles[3], 16, 16);
				}
			}
			break;

		case ice:
			for(int i = 0; i < 8; i++)
			{
				for(int j = 0; j < 8; j++)
				{
					if(mapArr[i][j] == 0) display->drawRGBBitmap(i*16, j*16, ice_tiles[0], 16, 16);
					else if(mapArr[i][j] == 1) display->drawRGBBitmap(i*16, j*16, ice_tiles[1], 16, 16);
					else if(mapArr[i][j] == 2) display->drawRGBBitmap(i*16, j*16, ice_tiles[2], 16, 16);
					else if(mapArr[i][j] == 4)
					{
						display->drawRGBBitmap(i*16, j*16, ice_tiles[0], 16, 16);
						display->drawRGBBitmap(i*16, j*16, epd_bitmap_Treasure, epd_bitmap_Treasure_Mask, 16, 16);
					}
					else if(mapArr[i][j] == 5)
					{
						display->drawRGBBitmap(i*16, j*16, ice_tiles[0], 16, 16);
						drawIcon(i*16, j*16, false, display, mon);
					}
					else display->drawRGBBitmap(i*16, j*16, ice_tiles[3], 16, 16);
				}
			}
			break;

		case sea:
			drawBorder(screen, display, mon);
			for(int i = 1; i < 7; i++)
			{
				for(int j = 1; j < 7; j++)
				{
					if(mapArr[i][j] == 0) display->drawRGBBitmap(i*16, j*16, sea_tiles[0], 16, 16);
					else if(mapArr[i][j] == 1) display->drawRGBBitmap(i*16, j*16, sea_tiles[1], 16, 16);
					else if(mapArr[i][j] == 2) display->drawRGBBitmap(i*16, j*16, sea_tiles[2], 16, 16);
					else if(mapArr[i][j] == 4)
					{
						display->drawRGBBitmap(i*16, j*16, sea_tiles[0], 16, 16);
						display->drawRGBBitmap(i*16, j*16, epd_bitmap_Treasure, epd_bitmap_Treasure_Mask, 16, 16);
					}
					else if(mapArr[i][j] == 5)
					{
						display->drawRGBBitmap(i*16, j*16, sea_tiles[0], 16, 16);
						drawIcon(i*16, j*16, false, display, mon);
					}
					else display->drawRGBBitmap(i*16, j*16, sea_tiles[3], 16, 16);
				}
			}
			break;

		case sky:
			drawBorder(screen, display, mon);
			for(int i = 1; i < 7; i++)
			{
				for(int j = 1; j < 7; j++)
				{
					if(mapArr[i][j] == 0) display->drawRGBBitmap(i*16, j*16, sky_tiles[0], 16, 16);
					else if(mapArr[i][j] == 1) display->drawRGBBitmap(i*16, j*16, sky_tiles[1], 16, 16);
					else if(mapArr[i][j] == 2) display->drawRGBBitmap(i*16, j*16, sky_tiles[2], 16, 16);
					else if(mapArr[i][j] == 4)
					{
						display->drawRGBBitmap(i*16, j*16, sky_tiles[0], 16, 16);
						display->drawRGBBitmap(i*16, j*16, epd_bitmap_Treasure, epd_bitmap_Treasure_Mask, 16, 16);
					}
					else if(mapArr[i][j] == 5)
					{
						display->drawRGBBitmap(i*16, j*16, sky_tiles[0], 16, 16);
						drawIcon(i*16, j*16, false, display, mon);
					}
					else display->drawRGBBitmap(i*16, j*16, sky_tiles[3], 16, 16);
				}
			}
			break;
			
		case limbo:
			drawBorder(screen, display, mon);
			for(int i = 1; i < 7; i++)
			{
				for(int j = 1; j < 7; j++)
				{
					if(mapArr[i][j] == 0) display->drawRGBBitmap(i*16, j*16, limbo_tiles[0], 16, 16);
					else if(mapArr[i][j] == 1) display->drawRGBBitmap(i*16, j*16, limbo_tiles[1], 16, 16);
					else if(mapArr[i][j] == 2) display->drawRGBBitmap(i*16, j*16, limbo_tiles[2], 16, 16);
					else if(mapArr[i][j] == 4)
					{
						display->drawRGBBitmap(i*16, j*16, limbo_tiles[0], 16, 16);
						display->drawRGBBitmap(i*16, j*16, epd_bitmap_Treasure, epd_bitmap_Treasure_Mask, 16, 16);
					}
					else if(mapArr[i][j] == 5)
					{
						display->drawRGBBitmap(i*16, j*16, limbo_tiles[0], 16, 16);
						drawIcon(i*16, j*16, false, display, mon);
					}
					else display->drawRGBBitmap(i*16, j*16, limbo_tiles[3], 16, 16);
				}
			}
			break;

		default:
			break;
	}
	display->refresh();
}

void Menus::drawBorder(maps screen, Sharp_Color_LCD *display, Player *mon)
{
	display->setRotation(1);
	switch (screen)
	{
		case sea:
			for(int i = 1; i < 5; i++)
			{
				display->setRotation(i % 4);
				display->drawRGBBitmap(112, 0, sea_tiles[4], 16, 16);
				for(int j = 1; j < 7; j++)
					display->drawRGBBitmap(112, j*16, sea_tiles[5], 16, 16);
			}
			display->setRotation(1);
			break;

		case sky:
			for(int i = 1; i < 5; i++)
			{
				display->setRotation(i % 4);
				display->drawRGBBitmap(112, 0, sky_tiles[4], 16, 16);
				for(int j = 1; j < 7; j++)
					display->drawRGBBitmap(112, j*16, sky_tiles[5], 16, 16);
			}
			display->setRotation(1);
			break;

		case limbo:
			for(int i = 1; i < 5; i++)
			{
				display->setRotation(i % 4);
				display->drawRGBBitmap(112, 0, limbo_tiles[4], 16, 16);
				for(int j = 1; j < 7; j++)
					display->drawRGBBitmap(112, j*16, limbo_tiles[5], 16, 16);
			}
			display->setRotation(1);
			break;
		
		default:
			break;
	}
}

void Menus::generateNewMap(maps screen)
{
	for(int i = 0; i < 8; i++)
	{
		for(int j = 0; j < 8; j++)
		{
			long rand = random(100);
			if(rand < 70) mapArr[i][j] = 0;
			else if(rand < 80) mapArr[i][j] = 1;
			else if(rand < 90) mapArr[i][j] = 2;
			else mapArr[i][j] = 3;

			if(screen == sea || screen == sky || screen == limbo)
			{
				if(i == 0 || i == 7 || j == 0 || j == 7)
					mapArr[i][j] = 3;
				else if(i == 1 && j == 1) mapArr[i][j] = 0;
			}
		}
	}
	
	bool visited[8][8];
	memset(visited, false, sizeof visited);

	if(screen == sea || screen == sky || screen == limbo)
		BFS(visited, 1, 1);
	else BFS(visited, 0, 0);

	for(int i = 0; i < 8; i++)
	{
		for(int j = 0; j < 8; j++)
		{
			if(mapArr[i][j] == 0 && visited[i][j] == false)
			{
				for (int k = 0; k < 4; k++)
				{
					int adjx = i + dRow[k];
					int adjy = j + dCol[k];
			
					if (isValid(visited, adjx, adjy) && mapArr[adjx][adjy] > 0)
					{
						mapArr[adjx][adjy] = 0;
						memset(visited, false, sizeof visited);
						if(screen == sea || screen == sky || screen == limbo)
							BFS(visited, 1, 1);
						else BFS(visited, 0, 0);
					}
				}
			}
		}
	}

	for(int i = 0; i < 8; i++)
	{
		for(int j = 0; j < 8; j++)
		{
			if(screen == sea || screen == sky || screen == limbo)
			{
				if(i == 0 || i == 7 || j == 0 || j == 7)
					mapArr[i][j] = 3;
				else if(i == 1 && j == 1) mapArr[i][j] = 0;
			}
		}
	}

	placeNewMarker();

	currAnim[0] = 2;

	for(int i = previous / 8; (i % 8) < 8; i++)
	{
		for(int j = previous % 8; j < 8; j++)
		{
			if(mapArr[i][j] == 0)
			{
				mapArr[i][j] = 5;
				x = i;
				y = j;
				return;
			}
		}
	}
}
 
bool Menus::isValid(bool vis[][8], int row, int col)
{
    // If cell lies out of bounds
    if (row < 0 || col < 0
        || row >= 8 || col >= 8)
        return false;
 
    // If cell is already visited
    if (vis[row][col])
        return false;
 
    // Otherwise
    return true;
}
 
void Menus::BFS(bool vis[][8], int row, int col)
{
    // Stores indices of the matrix cells
    std::queue<std::pair<int, int> > q;
 
    // Mark the starting cell as visited
    // and push it into the queue
    q.push({ row, col });
    vis[row][col] = true;
 
    // Iterate while the queue
    // is not empty
    while (!q.empty()) {
 
        std::pair<int, int> cell = q.front();
        int x = cell.first;
        int y = cell.second;
 
        q.pop();
 
        // Go to the adjacent cells
        for (int i = 0; i < 4; i++) {
 
            int adjx = x + dRow[i];
            int adjy = y + dCol[i];
 
            if (isValid(vis, adjx, adjy) && mapArr[adjx][adjy] == 0) {
                q.push({ adjx, adjy });
                vis[adjx][adjy] = true;
            }
        }
    }
}

void Menus::placeNewMarker(Sharp_Color_LCD *display, Player *mon)
{
	display->setRotation(1);
	long rand = random(64);
	while (mapArr[rand / 8][rand % 8] > 0) rand = random(64);

	mapArr[previous / 8][previous % 8] = 0;

	switch (currSubMenu)
	{
		case desert:
			display->drawRGBBitmap((previous / 8)*16, (previous % 8)*16, desert_tiles[0], 16, 16);
			break;
		case ice:
			display->drawRGBBitmap((previous / 8)*16, (previous % 8)*16, ice_tiles[0], 16, 16);
			break;
		case sea:
			display->drawRGBBitmap((previous / 8)*16, (previous % 8)*16, sea_tiles[0], 16, 16);
			break;
		case sky:
			display->drawRGBBitmap((previous / 8)*16, (previous % 8)*16, sky_tiles[0], 16, 16);
			break;
		case limbo:
			display->drawRGBBitmap((previous / 8)*16, (previous % 8)*16, limbo_tiles[0], 16, 16);
			break;
	}

	previous = rand;

	mapArr[rand / 8][rand % 8] = 4;
	display->drawRGBBitmap((rand / 8)*16, (rand % 8)*16, epd_bitmap_Treasure, epd_bitmap_Treasure_Mask, 16, 16);
	display->refresh();
}

void Menus::placeNewMarker()
{
	long rand = random(64);
	while (mapArr[rand / 8][rand % 8] > 0) rand = random(64);

	previous = rand;

	mapArr[rand / 8][rand % 8] = 4;
}

void Menus::gameTick(commands input, Sharp_Color_LCD *display, Player *mon)
{
	switch (input)
	{
		case right:
			new_dir[0] = dir[1];
			new_dir[1] = -1 * dir[0];
			dir[0] = new_dir[0];
			dir[1] = new_dir[1];

			if(dir[0] != 0) currAnim[0] = 1;
			else if(dir[1] == 1) currAnim[0] = 2;
			else currAnim[0] = 0;
			break;

		case left:
			new_dir[0] = -1 * dir[1];
			new_dir[1] = dir[0];
			dir[0] = new_dir[0];
			dir[1] = new_dir[1];

			if(dir[0] != 0) currAnim[0] = 1;
			else if(dir[1] == 1) currAnim[0] = 2;
			else currAnim[0] = 0;
			break;

		case confirm:
			int targetVal = 0;
			
			if(x+dir[0] >= 0 && x+dir[0] < 8 && y-dir[1] >= 0 && y-dir[1] < 8)
			{
				targetVal = mapArr[x+dir[0]][y-dir[1]];

				if(targetVal == 0)
				{
					switch (currSubMenu)
					{
						case desert:
							display->drawRGBBitmap(x*16, y*16, desert_tiles[0], 16, 16);
							break;
						case ice:
							display->drawRGBBitmap(x*16, y*16, ice_tiles[0], 16, 16);
							break;
						case sea:
							display->drawRGBBitmap(x*16, y*16, sea_tiles[0], 16, 16);
							break;
						case sky:
							display->drawRGBBitmap(x*16, y*16, sky_tiles[0], 16, 16);
							break;
						case limbo:
							display->drawRGBBitmap(x*16, y*16, limbo_tiles[0], 16, 16);
							break;
					}
					drawIcon((x+dir[0])*16, (y-dir[1])*16, false, display, mon);
					mapArr[x][y] = 0;
					x = x+dir[0];
					y = y-dir[1];
					mapArr[x][y] = 5;
				}
				else if(targetVal == 4)
				{
					score++;
					placeNewMarker(display, mon);
					switch (currSubMenu)
					{
						case desert:
							display->drawRGBBitmap(x*16, y*16, desert_tiles[0], 16, 16);
							break;
						case ice:
							display->drawRGBBitmap(x*16, y*16, ice_tiles[0], 16, 16);
							break;
						case sea:
							display->drawRGBBitmap(x*16, y*16, sea_tiles[0], 16, 16);
							break;
						case sky:
							display->drawRGBBitmap(x*16, y*16, sky_tiles[0], 16, 16);
							break;
						case limbo:
							display->drawRGBBitmap(x*16, y*16, limbo_tiles[0], 16, 16);
							break;
					}
					drawIcon((x+dir[0])*16, (y-dir[1])*16, false, display, mon);
					mapArr[x][y] = 0;
					x = x+dir[0];
					y = y-dir[1];
					mapArr[x][y] = 5;
				}
			}
			break;
	}
	display->refresh();
}

void Menus::drawMain(Sharp_Color_LCD *display, Player *mon)
{
	display->setRotation(1);
	display->drawBitmap(0, 0, main2, 128, 128, 0x0000);
	switch(currSubMenu)
	{
		case stats:
			display->drawBitmap(48, 48, statsIcon, 32, 32, 0x0000);
			drawIcon(0, 56, false, display, mon);
			drawIcon(112, 56, false, display);
			break;
		case farm:
			drawIcon(48, 48, true, display, mon);
			drawIcon(0, 56, false, display);
			display->drawBitmap(112, 56, statsMini, 16, 16, 0x0000);
			break;
		case game:
			drawIcon(48, 48, true, display);
			display->drawBitmap(0, 56, statsMini, 16, 16, 0x0000);
			drawIcon(112, 56, false, display, mon);
			break;
	}
	
	display->setCursor(2, 2);
	display->setTextColor(0x0000);
	display->setTextSize(2);
	display->printf("%d\n", mon->lifetimeCount);
	display->refresh();
}

void Menus::updateMain(commands input, Sharp_Color_LCD *display, Player *mon)
{
	display->fillScreen(0xFFFF);
	switch (input)
	{
	case left:
		currSubMenu--;
		if(currSubMenu < 0) currSubMenu = 2;
		drawMain(display, mon);
		break;
	case right:
		currSubMenu++;
		currSubMenu %= 3;
		drawMain(display, mon);
		break;
	case confirm:
		changeMenu(currSubMenu, 0, display, mon);
		break;
	}
}

void Menus::updateFarm(commands input, Sharp_Color_LCD *display, Player *mon)
{
	switch (input)
	{
		case confirm:
			mon->setPrimary();
			changeMenu(front, 0, display, mon);
			break;
			
		case left:
			mon->getPrev();
			farmMenu(display, mon);
			break;

		case right:
			mon->getNext();
			farmMenu(display, mon);
			break;
	}
}

void Menus::endGame(Sharp_Color_LCD *display, Player *mon)
{
	display->setRotation(1);
	if(score >= 15) mon->mult = 3;
	else if(score >= 10) mon->mult = 2;

	display->setCursor(17, 32);
	display->setTextSize(1.5f);
	display->println("Final Score");
	display->setCursor(54, 43);
	display->setTextSize(2);
	display->printf("%02d", score);
	display->setCursor(22, 72);
	display->setTextSize(1);
	display->printf("Multiplier: %dx", mon->mult);

	score = 0;
	dir[0] = 0;
	dir[1] = 1;
	new_dir[0] = 0;
	new_dir[1] = 1;
	x = 0;
	y = 0;

	display->refresh();
}

void Menus::drawStats(Sharp_Color_LCD *display, Player *mon)
{
	display->setRotation(1);
	display->setCursor(4, 4);
	display->setTextSize(1.5f);
	display->printf("Steps \n      %d\n", mon->lifetimeCount);
	display->setCursor(4, 36);
	display->printf("Multiplier \n           %d\n", mon->mult);

	display->drawRGBBitmap(8, 72, desert_tiles[0], 16, 16);
	display->drawRGBBitmap(32, 72, ice_tiles[1], 16, 16);
	display->drawRGBBitmap(56, 72, sea_tiles[5], 16, 16);
	display->drawRGBBitmap(80, 72, sky_tiles[5], 16, 16);
	display->drawRGBBitmap(104, 72, limbo_tiles[5], 16, 16);

	for(int i = 0; i < 4; i++)
		display->drawFastHLine(26+(i*24), 80, 4, 0x0000);

	for(int i = mon->size; i < 5; i++)
		display->drawBitmap(8+(i*24), 72, epd_bitmap_Lock, 16, 16, 0x0000);

	display->fillTriangle(13+(currMap*24), 95, 18+(currMap*24), 95, 16+(currMap*24), 92, 0x0000);
	display->fillTriangle(13+(currMap*24), 95, 18+(currMap*24), 95, 15+(currMap*24), 92, 0x0000);
	
	display->refresh();
}

void Menus::updateStats(commands input, Sharp_Color_LCD *display, Player *mon)
{
	switch (input)
	{
		case confirm:
			changeMenu(front, 0, display, mon);
			break;
		
		case left:
			currMap--;
			if(currMap < 0) currMap = mon->size - 1;

			display->fillScreen(0xFFFF);
			drawStats(display, mon);
			break;

		case right:
			currMap++;
			if(currMap >= mon->size) currMap = 0;

			display->fillScreen(0xFFFF);
			drawStats(display, mon);
			break;
	}
}